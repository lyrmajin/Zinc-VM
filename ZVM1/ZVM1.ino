#define MAX_REG 4
#define MAX_MEM 1024
#define GPR0 0
#define GPR1 1
#define GPR2 2
#define PC 3
uint8_t REGISTER[MAX_REG] = {0};
uint8_t MEMORY[MAX_MEM];
uint8_t FL = 0;
void OP_MVI() { // 0000
  REGISTER[GPR0] = (MEMORY[REGISTER[PC]] & 0b00001111);
}
void OP_MOV(){ // 0001
  REGISTER[(MEMORY[REGISTER[PC]] & 0b00001100) >> 0x02] = REGISTER[(MEMORY[REGISTER[PC]] & 0b00000011)];
}
void OP_ADD(){ //0010
  REGISTER[(MEMORY[REGISTER[PC]] & 0b00001100) >> 0x02] += REGISTER[(MEMORY[REGISTER[PC]] & 0b00000011)];
}
void OP_SUB(){ //0011
  REGISTER[(MEMORY[REGISTER[PC]] & 0b00001100) >> 0x02] -= REGISTER[(MEMORY[REGISTER[PC]] & 0b00000011)];
}
void OP_AND(){ //0100
  REGISTER[(MEMORY[REGISTER[PC]] & 0b00001100) >> 0x02] &= REGISTER[(MEMORY[REGISTER[PC]] & 0b00000011)];
}
void OP_OR(){ //0101
  REGISTER[(MEMORY[REGISTER[PC]] & 0b00001100) >> 0x02] |= REGISTER[(MEMORY[REGISTER[PC]] & 0b00000011)];
}
void OP_XOR(){ //0110
  REGISTER[(MEMORY[REGISTER[PC]] & 0b00001100) >> 0x02] ^= REGISTER[(MEMORY[REGISTER[PC]] & 0b00000011)];
}
void OP_CMP(){ //0111
  FL = (REGISTER[(MEMORY[REGISTER[PC]] & 0b00001100) >> 0x02] - REGISTER[(MEMORY[REGISTER[PC]] & 0b00000011)]) & 0b00000001;
}
void OP_LD(){ //1000
  MEMORY[REGISTER[(MEMORY[REGISTER[PC]] & 0b00001100) >> 0x02]] = REGISTER[(MEMORY[REGISTER[PC]] & 0b00000011)];
}
void OP_ST(){ //1001
  REGISTER[(MEMORY[REGISTER[PC]] & 0b00001100) >> 0x02] = MEMORY[REGISTER[(MEMORY[REGISTER[PC]] & 0b00000011)]];
}
void OP_JMP(){ //1010
  REGISTER[PC] = REGISTER[(MEMORY[REGISTER[PC]] & 0b00000011)];
}
void OP_BRZ(){ //1011
  if (FL == 0)
    REGISTER[PC] = REGISTER[(MEMORY[REGISTER[PC]] & 0b00000011)];
}
void OP_SHL(){ //1100
  REGISTER[(MEMORY[REGISTER[PC]] & 0b00001100) >> 0x02] = REGISTER[(MEMORY[REGISTER[PC]] & 0b00001100) >> 0x02] << REGISTER[(MEMORY[REGISTER[PC]] & 0b00000011)];
}
void OP_SHR(){ //1101
  REGISTER[(MEMORY[REGISTER[PC]] & 0b00001100) >> 0x02] = REGISTER[(MEMORY[REGISTER[PC]] & 0b00001100) >> 0x02] >> REGISTER[(MEMORY[REGISTER[PC]] & 0b00000011)];
}
void OP_SCB(){ //1110
  REGISTER[(MEMORY[REGISTER[PC]] & 0b00001100) >> 0x02] ^= (1 << REGISTER[(MEMORY[REGISTER[PC]] & 0b00000011)]);
}
void OP_HLT(){ //1111
  FL &= 0b01111111;
}
typedef void (*OPCODE)();
const OPCODE OPCODES[16] = {OP_MVI, OP_MOV, OP_ADD, OP_SUB, OP_AND, OP_OR, OP_XOR, OP_CMP, OP_LD, OP_ST, OP_JMP, OP_BRZ, OP_SHL, OP_SHR, OP_SCB, OP_HLT};
void setup() {
  Serial.begin(9600);
  FL |= 0b10000000;
  REGISTER[PC] -= 1;
}
void loop() {
  while((FL & 0b10000000)){
  REGISTER[PC]++;
  OPCODES[((MEMORY[REGISTER[PC]] & 0b11110000) >> 0x04)]();
  Serial.print("MEMORY[PC]:");
  Serial.println(MEMORY[REGISTER[PC]], BIN);
  for (int i = 0; i < MAX_REG; i++) {
    Serial.print("REGISTER[");
    Serial.print(i);
    Serial.print("]:");
    Serial.println(REGISTER[i], BIN);
  }
  Serial.print("FLAGS:");
  Serial.println(FL, BIN);
  }
}
